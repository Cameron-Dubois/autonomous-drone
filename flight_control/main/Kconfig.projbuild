## flight_control/main/Kconfig.projbuild
```kconfig
menu "ICM-42670-P IMU Configuration"

    config IMU_I2C_SDA_GPIO
        int "I2C SDA GPIO number"
        default 4
        range 0 21
        help
            GPIO pin for I2C SDA line connected to the ICM-42670-P.

    config IMU_I2C_SCL_GPIO
        int "I2C SCL GPIO number"
        default 5
        range 0 21
        help
            GPIO pin for I2C SCL line connected to the ICM-42670-P.

    config IMU_I2C_FREQ_HZ
        int "I2C clock frequency (Hz)"
        default 400000
        range 100000 1000000
        help
            I2C master clock frequency. The ICM-42670-P supports up to 1 MHz.
            400 kHz (Fast Mode) is a safe default.

    config IMU_AD0_HIGH
        bool "AD0 pin is pulled HIGH (I2C address 0x69)"
        default n
        help
            When the ICM-42670-P AP_AD0 pin is tied HIGH the 7-bit
            I2C address becomes 0x69 instead of the default 0x68.

endmenu

menu "Motor Configuration (DSHOT300)"

    config MOTOR_1_PWM_GPIO
        int "Motor 1 DSHOT signal GPIO"
        default 3
        range 0 21
        help
            DSHOT300 line to ESC 1 (legacy symbol name: *_PWM_GPIO).

    config MOTOR_2_PWM_GPIO
        int "Motor 2 DSHOT signal GPIO"
        default 4
        range 0 21
        help
            DSHOT line to ESC 2.

    config MOTOR_3_PWM_GPIO
        int "Motor 3 DSHOT signal GPIO"
        default 5
        range 0 21
        help
            DSHOT line to ESC 3.

    config MOTOR_4_PWM_GPIO
        int "Motor 4 DSHOT signal GPIO"
        default 6
        range 0 21
        help
            DSHOT line to ESC 4.

endmenu
```

## flight_control/sdkconfig.defaults
```kconfig
#targeting the ESP32-C3
CONFIG_IDF_TARGET="esp32c3"

#I2C pins for the ESP32-C3-DevKit-RUST-1 board
#the ICM-42670-P is hardwired to GPIO10 (SDA) and GPIO8 (SCL) on this board
CONFIG_IMU_I2C_SDA_GPIO=10
CONFIG_IMU_I2C_SCL_GPIO=8
CONFIG_IMU_I2C_FREQ_HZ=400000

#Brushless 4-in-1 ESC: DSHOT300 on GPIO3–6 (same pinout as motor_tests)
CONFIG_MOTOR_1_PWM_GPIO=3
CONFIG_MOTOR_2_PWM_GPIO=4
CONFIG_MOTOR_3_PWM_GPIO=5
CONFIG_MOTOR_4_PWM_GPIO=6

#bigger stack so we don't overflow with all the printf calls
CONFIG_ESP_MAIN_TASK_STACK_SIZE=4096

# --- BLE (NimBLE) for the mobile-app command link --------------------------
# Mirrors drone_ble/sdkconfig.defaults so flight_control speaks the same
# protocol as drone_ble (same UUIDs, same drone_cmd_t/drone_ack_t format).
CONFIG_BT_ENABLED=y
CONFIG_BT_BLUEDROID_ENABLED=n
CONFIG_BT_NIMBLE_ENABLED=y
```

## flight_sim/sdkconfig.defaults
```kconfig
#targeting the ESP32-C3
CONFIG_IDF_TARGET="esp32c3"

#bigger stack for the control loop + UART handling
CONFIG_ESP_MAIN_TASK_STACK_SIZE=4096

#suppress most logging so binary UART packets don't get corrupted
CONFIG_LOG_DEFAULT_LEVEL_WARN=y
```

## server_update/sdkconfig.defaults
```kconfig
# ----------------------------------------------------------------------------
# sdkconfig.defaults  -- baseline tuning for an ESP32-C3 WiFi drone
# Generated for: real-time flight control + UDP control link
#
# Override anything you like with `idf.py menuconfig`.  These values are picked
# to favor low-jitter control loops and low-latency UDP packet delivery.
# ----------------------------------------------------------------------------

CONFIG_IDF_TARGET="esp32c3"

# --- CPU / clocks ---------------------------------------------------------
# Run the C3 at its top speed.  We need the headroom for the 1 kHz control
# loop + WiFi.
CONFIG_ESPTOOLPY_FLASHFREQ_80M=y
CONFIG_ESP_DEFAULT_CPU_FREQ_MHZ_160=y
CONFIG_ESP_DEFAULT_CPU_FREQ_MHZ=160

# --- FreeRTOS -------------------------------------------------------------
# 1000 Hz tick gives us 1 ms scheduling granularity, which matches our
# control-loop period.  The C3 is single core, so no pinning gymnastics.
CONFIG_FREERTOS_HZ=1000
CONFIG_FREERTOS_USE_TICKLESS_IDLE=n
CONFIG_FREERTOS_CHECK_STACKOVERFLOW_CANARY=y

# --- Compiler / size ------------------------------------------------------
# -O2 is the right default for a flight controller: the extra speed matters,
# and the binary still fits comfortably.
CONFIG_COMPILER_OPTIMIZATION_PERF=y
CONFIG_COMPILER_OPTIMIZATION_ASSERTIONS_DISABLE=n
CONFIG_COMPILER_STACK_CHECK_MODE_NORM=y

# --- Watchdogs ------------------------------------------------------------
# Interrupt watchdog catches stuck ISRs; task watchdog catches stuck tasks.
# The flight task feeds the TWDT every loop.
CONFIG_ESP_INT_WDT=y
CONFIG_ESP_INT_WDT_TIMEOUT_MS=300
CONFIG_ESP_TASK_WDT_INIT=y
CONFIG_ESP_TASK_WDT_TIMEOUT_S=2
CONFIG_ESP_TASK_WDT_PANIC=y

# --- WiFi -----------------------------------------------------------------
# Smaller buffers + AMPDU off favors low latency over throughput.  Drones
# care about the next packet, not aggregate Mbps.
CONFIG_ESP_WIFI_STATIC_RX_BUFFER_NUM=10
CONFIG_ESP_WIFI_DYNAMIC_RX_BUFFER_NUM=16
CONFIG_ESP_WIFI_DYNAMIC_TX_BUFFER_NUM=16
CONFIG_ESP_WIFI_AMPDU_TX_ENABLED=n
CONFIG_ESP_WIFI_AMPDU_RX_ENABLED=n
CONFIG_ESP_WIFI_NVS_ENABLED=y

# --- lwIP (UDP-favored) ---------------------------------------------------
CONFIG_LWIP_TCP_MSL=5000
CONFIG_LWIP_MAX_SOCKETS=6
CONFIG_LWIP_SO_RCVBUF=y
CONFIG_LWIP_IP_FORWARD=n

# --- Logging --------------------------------------------------------------
# Default to INFO; flip to WARN at the bench once tuning is done to free a
# few cycles in the hot path.
CONFIG_LOG_DEFAULT_LEVEL_INFO=y

# --- Power management -----------------------------------------------------
# We want consistent latency, not power saving.
CONFIG_PM_ENABLE=n
```

## wifi_gps_softap/main/Kconfig.projbuild
```kconfig
menu "Example Configuration"

    config ESP_WIFI_SSID
        string "WiFi SSID"
        default "myssid"
        help
            SSID (network name) for the SoftAP.

    config ESP_WIFI_PASSWORD
        string "WiFi Password"
        default "mypassword"
        help
            WiFi password (WPA or WPA2) for the SoftAP.

    config ESP_WIFI_CHANNEL
        int "WiFi Channel"
        range 1 13
        default 1
        help
            WiFi channel for the SoftAP.

    config ESP_MAX_STA_CONN
        int "Maximal STA connections"
        default 4
        help
            Max number of STAs that can connect to the AP.
endmenu

menu "NimBLE security"

    choice EXAMPLE_USE_IO_TYPE
        prompt "I/O Capability"
        default BLE_SM_IO_CAP_NO_IO
        help
            I/O capability of device.

        config BLE_SM_IO_CAP_DISP_ONLY
            bool "DISPLAY ONLY"
        config BLE_SM_IO_CAP_DISP_YES_NO
            bool "DISPLAY YESNO"
        config BLE_SM_IO_CAP_KEYBOARD_ONLY
            bool "KEYBOARD ONLY"
        config BLE_SM_IO_CAP_NO_IO
            bool "Just works"
        config BLE_SM_IO_CAP_KEYBOARD_DISP
            bool "Both KEYBOARD & DISPLAY"
    endchoice

    config EXAMPLE_IO_TYPE
        int
        default 0 if BLE_SM_IO_CAP_DISP_ONLY
        default 1 if BLE_SM_IO_CAP_DISP_YES_NO
        default 2 if BLE_SM_IO_CAP_KEYBOARD_ONLY
        default 3 if BLE_SM_IO_CAP_NO_IO
        default 4 if BLE_SM_IO_CAP_KEYBOARD_DISP

    config EXAMPLE_BONDING
        bool
        default n
        prompt "Use Bonding"

    config EXAMPLE_MITM
        bool
        default n
        prompt "MITM security"

    config EXAMPLE_USE_SC
        bool
        depends on BT_NIMBLE_SM_SC
        default n
        prompt "Use Secure Connection feature"

    config EXAMPLE_EXTENDED_ADV
        bool
        depends on SOC_BLE_50_SUPPORTED && BT_NIMBLE_50_FEATURE_SUPPORT
        default n
        select BT_NIMBLE_EXT_ADV
        prompt "Enable Extended Adv"

    config EXAMPLE_RANDOM_ADDR
        bool
        default n
        prompt "Advertise RANDOM Address"

    config EXAMPLE_ENCRYPTION
        bool
        default n
        prompt "Enable Link Encryption"

    config EXAMPLE_RESOLVE_PEER_ADDR
        bool
        default n
        prompt "Enable resolving peer address"

endmenu
```

## wifi_gps_softap/sdkconfig.defaults
```kconfig
# Enable WebSocket support for secure /ws handler on HTTPS server
CONFIG_HTTPD_WS_SUPPORT=y

# NimBLE (BLE peripheral alongside Wi-Fi on ESP32-C3)
CONFIG_BT_ENABLED=y
CONFIG_BT_NIMBLE_ENABLED=y

# App image exceeds default 1MB factory with BT + Wi-Fi + mbedTLS
CONFIG_PARTITION_TABLE_CUSTOM=y
CONFIG_PARTITION_TABLE_CUSTOM_FILENAME="partitions.csv"
CONFIG_PARTITION_TABLE_OFFSET=0x8000
```
